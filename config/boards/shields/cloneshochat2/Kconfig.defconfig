## config/boards/shields/cloneshochat2/Kconfig.defconfig
```kconfig
if SHIELD_CLONESHOCHAT2

config ZMK_KEYBOARD_NAME
    default "cloneshochat2"

endif
```

## config/boards/shields/cloneshochat2/Kconfig.shield
```kconfig
config SHIELD_CLONESHOCHAT2
    def_bool $(shields_list_contains, cloneshochat2)
```

## config/boards/shields/cloneshochat2/kconfig.shield
```kconfig
# SPDX-License-Identifier: Zlib
config SHIELD_CLONESHOCHAT2
    bool "Cloneshochat2 Shield"
    depends on BOARD_NICE_NANO
    select ZMK_KEYSCAN_GPIO
    help
      Enable the Cloneshochat2 shield.
```
